## drivers/aura_sync/Kconfig
```kconfig
config AURA_SYNC_INBOX
	tristate "aura_sync_inbox"
    bool "aura_sync_inbox"
    default m
	help
		Enable aura_sync_inbox kernel module

config AURA_SYNC_STATION
	tristate "aura_sync_station"
    bool "aura_sync_station"
    default m
	help
		Enable aura_sync_station kernel module

config AURA_SYNC_POGO
    tristate "aura_sync_station"
    bool "aura_sync_station"
    default m
	help
		Enable aura_sync_station kernel module
```

## drivers/dt_power/Kconfig
```kconfig
config DT_POWER
	tristate "dt_power"
    bool "dt_power"
    default m
	help
		Enable aura_sync_inbox kernel module
```

## drivers/gamepad_hid_driver/Kconfig
```kconfig
config GAMEPAD_HID
	bool "Asus Kuni Gamepad"
	default y
	depends on USB_HID
	help
		Enable GamePad driver
```

## drivers/input/fingerprint/Kconfig
```kconfig
config GOODIX_FINGERPRINT
	tristate "generic goodix fingerprint driver"
	help
	  add support for goodix fingerprint driver.
```

## drivers/input/fingerprint3626/Kconfig
```kconfig
config GOODIX3626_FINGERPRINT
	tristate "generic goodix fingerprint driver"
	help
	add support for goodix fingerprint driver.
	To compile this driver as a module, choose M here: the
	  module will be called fingerprint.
```

## drivers/input/touchscreen/station_goodix_gtx8/Kconfig
```kconfig
#
# Goodix touchscreen driver configuration
#
menuconfig TOUCHSCREEN_GOODIX_GTX8_STATION
	bool "Goodix GTx8 touchscreen"
	depends on I2C
	default n
	help
	  Say Y here if you have a Goodix GTx8 touch controller
	  to your system.

	  If unsure, say N.

if TOUCHSCREEN_GOODIX_GTX8_STATION

config TOUCHSCREEN_GOODIX_GTX8_UPDATE_STATION
	tristate "Goodix GTx8 firmware update module"
	default n
	help
	  Say Y here to enable support for doing firmware update.

	  If unsure, say N.

	  To compile this driver as a module, choose M here.

config TOUCHSCREEN_GOODIX_GTX8_GESTURE_STATION
	tristate "Goodix GTx8 gesture wakeup feature"
	default n
	help
	  Say Y here to enable support for gesture wakeup feature..

	  If unsure, say N.

	  To compile this driver as a module, choose M here.

config TOUCHSCREEN_GOODIX_GTX8_TOOLS_STATION
	tristate "Goodix touch tools support"
	default n
	help
	  Say Y here to enable debug tools.

	  If unsure, say N.

	  To compile this driver as a module, choose M here.
 
config TOUCHSCREEN_GOODIX_GTX8_SUPPORT
	tristate "Goodix touch support station"
	default n
	help
	  Say Y here to enable drm panel suspend/resume notify.

	  If unsure, say N.

	  To compile this driver as a module, choose M here.

config TOUCHSCREEN_GOODIX_DRM_NOTIFY
	tristate "Goodix touch support drm panel suspend/resume notify"
	default n
	help
	  Say Y here to enable drm panel suspend/resume notify.

	  If unsure, say N.

	  To compile this driver as a module, choose M here.
	  
endif
```

## drivers/motor/tspdrv_aw8697/Kconfig
```kconfig
menu "TouchSense driver support"

config TSPDRV_AW8697
	tristate "TouchSense driver support"
	default n

endmenu
```

## drivers/platform/asus/Kconfig
```kconfig
# Asus configuration options

config MACH_ASUS
	bool "Asus device"
	help
	  Support for Asus products

config MACH_ASUS_KONA
	bool "Asus KONA"
	depends on ARCH_KONA
	select MACH_ASUS
	help
	  Support for KONA Asus variants

menu "Asus board selection"

config MACH_ASUS_ZS670KS
	bool "ZS670KS board"
	select MACH_ASUS_KONA
	help
	  Support for Zenfone 7 (tequila)

config MACH_ASUS_ZS661KS
	bool "ZS661KS board"
	select MACH_ASUS_KONA
	help
	  Support for Rog 3 (obiwan)

endmenu
```

## drivers/power/Kconfig
```kconfig
source "drivers/power/avs/Kconfig"
source "drivers/power/reset/Kconfig"
source "drivers/power/supply/Kconfig"
source "drivers/power/qcom/Kconfig"

config CHARGER_PCA9468
	tristate "NXP PCA9468 2:1 direct charger support"
	depends on I2C
	help
	  Say Y to enable support for the NXP PCA9468 battery charger.
```

## drivers/tuxera/Kconfig
```kconfig
menu "tuxera user/userdebug control"

config TUXERA_USERDEBUG
	tristate "tuxera user/userdebug control"
	default n

endmenu
```

## techpack/datarmnet/Kconfig
```kconfig
menu "Qualcomm RmNet Extensions"

source "techpack/datarmnet/drivers/rmnet/Kconfig"

endmenu
```

## techpack/datarmnet/drivers/rmnet/Kconfig
```kconfig
source "techpack/datarmnet/drivers/rmnet/perf/Kconfig"
source "techpack/datarmnet/drivers/rmnet/shs/Kconfig"
```
