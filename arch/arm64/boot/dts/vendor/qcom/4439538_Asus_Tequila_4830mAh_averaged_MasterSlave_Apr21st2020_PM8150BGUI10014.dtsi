
qcom,4439538_asus_tequila_4830mah_averaged_masterslave_apr21st2020 {
	qcom,profile-revision = <24>;
	/* #4439538_Asus_Tequila_4830mAh_averaged_MasterSlave_Apr21st2020*/
	qcom,max-voltage-uv = <4350000>;
	qcom,fg-cc-cv-threshold-mv = <4340>;
	qcom,nom-batt-capacity-mah = <4830>;
	qcom,batt-id-kohm = <100>;
	qcom,battery-beta = <4250>;
	qcom,therm-room-temp = <100000>;
	qcom,battery-type = "4439538_asus_tequila_4830mah_averaged_masterslave_apr21st2020";
	qcom,therm-coefficients = <0x2318 0xd0c 0xdaf7 0xc556 0x848d>;
	qcom,therm-center-offset = <0x70>;
	qcom,therm-pull-up = <100>;
	qcom,rslow-normal-coeffs = <0x8b 0x07 0xdb 0x12>;
	qcom,rslow-low-coeffs = <0x34 0x0c 0x54 0x03>;
	qcom,checksum = <0x0DA4>;
	qcom,gui-version = "PM855GUI - 1.0.0.14";
	qcom,fg-profile-data = [
		 09 00 2B EA
		 10 DD 91 E2
		 33 DD 00 00
		 E2 BD 6D 83
		 FD 87 87 8D
		 02 92 E0 87
		 1A 00 8B 07
		 DB 12 85 FC
		 68 01 CE 07
		 32 00 25 F2
		 77 ED 86 DC
		 AE 0A 4E E4
		 B3 CD 05 13
		 2B 03 59 DB
		 60 00 43 00
		 43 00 43 00
		 3B 00 30 00
		 35 00 39 00
		 46 00 42 00
		 42 00 60 00
		 3A 00 38 00
		 3E 00 3B 00
		 35 00 4F 00
		 4D 64 42 00
		 3E 00 3E 08
		 60 F8 62 00
		 50 00 4B 10
		 4C 10 3F 00
		 61 20 57 48
		 4D 58 48 0E
		 45 00 D8 00
		 8C 20 98 0C
		 DF FA 65 FC
		 67 1C 47 03
		 D7 05 21 22
		 32 18 D0 43
		 ED 55 25 03
		 77 13 F5 1F
		 45 05 8F 0A
		 95 FC F0 1C
		 65 FB 76 04
		 EE 03 61 18
		 EA 22 B0 45
		 86 52 83 14
		 AF 1F 9D 05
		 4D CA 07 CD
		 EE 1C B3 B2
		 D6 05 98 BA
		 70 18 B7 8A
		 F1 85 24 8A
		 8D 98 09 80
		 43 F0 E0 04
		 1C F2 77 03
		 00 00 81 DD
		 D4 EA F7 07
		 89 DB 6A C5
		 37 10 14 F8
		 B1 DD 82 03
		 89 04 D2 00
		 CE 07 32 00
		 88 01 A6 02
		 B4 04 15 02
		 57 05 E4 02
		 12 02 7F 02
		 04 05 4E 00
		 3B 00 40 00
		 42 64 46 00
		 44 F8 45 00
		 47 E8 43 00
		 47 00 3E 10
		 3E 10 38 00
		 46 20 48 40
		 50 58 5C 0E
		 45 00 4E 00
		 4C 08 52 00
		 46 00 3E 00
		 38 08 44 08
		 44 00 54 20
		 5F 40 46 58
		 4B 0F 49 00
		 48 00 34 08
		 D8 00 32 1F
		 A9 05 55 0A
		 2D 0D E1 1C
		 17 23 FA 45
		 0B 52 8F 18
		 C5 03 07 04
		 E8 02 68 11
		 3F 0A 25 21
		 2A 04 55 03
		 8D 05 E0 1C
		 84 02 08 05
		 F2 02 98 18
		 7A 03 8E 04
		 5C 02 81 00
		 A5 1F B4 05
		 58 02 5F 06
		 C8 1C 71 02
		 1E 05 08 03
		 A0 18 16 03
		 38 05 79 03
		 74 00 73 01
		 C0 00 FA 00
		 7B 12 00 00
	];
};
