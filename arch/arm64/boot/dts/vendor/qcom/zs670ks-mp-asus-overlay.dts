/dts-v1/;
/plugin/;

#include "zs670ks-pr-asus-overlay.dts"

/ {
	model = "Qualcomm Technologies, Inc. kona ZF7 MP";
	compatible = "qcom,kona-mtp", "qcom,kona", "qcom,mtp";
	qcom,board-id = <90 0>;
};



/*    ====================================
 *    overlay for kona-v2.dtsi - start
 *    ====================================
 */

/*    ====================================
 *    overlay for kona-v2.dtsi - end
 *    ====================================
 */



/*    ====================================
 *    overlay for kona.dtsi - start
 *    ====================================
 */

 /*    ====================================
 *    overlay for kona.dtsi - end
 *    ====================================
 */


/*    ====================================
 *    overlay for kona-mtp.dtsi - start
 *    ====================================
 */

/*    ====================================
 *    overlay for kona-mtp.dtsi -end
 *    ====================================
 */

/*    ====================================
 *    overlay for kona-pinctrl.dtsi - start
 *    ====================================
 */

/*    ====================================
 *    overlay for kona-pinctrl.dtsi - end
 *    ====================================
 */



/*    ====================================
 *    overlay for kona-pmic-overlay.dtsi  - start
 *    ====================================
 */

/*    ====================================
 *    overlay for kona-pmic-overlay.dtsi - end
 *    ====================================
 */



/*    ====================================
 *    overlay for kona-regulator.dtsi - start
 *    ====================================
 */

/*    ====================================
 *    overlay for kona-regulator.dtsi - end
 *    ====================================
 */
 


/*    ====================================
 *    overlay for kona-audio-overlay.dtsi - start
 *    ====================================
 */

/*    ====================================
 *    overlay for kona-audio-overlay.dtsi - end
 *    ====================================
 */




/*    ====================================
 *    overlay for kona-camera-sensor-mtp.dtsi - start
 *    ====================================
 */

/*    ====================================
 *    overlay for kona-camera-sensor-mtp.dtsi - end
 *    ====================================
 */
